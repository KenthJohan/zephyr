## drivers/sensor/tmc2130/Kconfig
```kconfig
# TMC2130, Stepper driver

# Copyright (c) 2020 None
# SPDX-License-Identifier: Apache-2.0

config TMC2130
	bool "TMC2130 stepper driver"
	depends on SPI
	help
	  Enable driver for TMC2130 SPI-based stepper driver.
```

## dts/bindings/sensor/trinamic,tmc2130.yaml
```yaml
# Copyright (c) 2020, None
# SPDX-License-Identifier: Apache-2.0

description: TMC2130 integrated stepper driver

compatible: "trinamic,tmc2130"

include: spi-device.yaml
```
